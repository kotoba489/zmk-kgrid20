## config/boards/shields/k_grid/Kconfig.shield
```kconfig
config SHIELD_KGRID20_LEFT
    def_bool $(shields_list_contains,kgrid20_left)

config SHIELD_KGRID20_RIGHT
    def_bool $(shields_list_contains,kgrid20_right)
```

## config/boards/shields/totem/Kconfig.shield
```kconfig
config SHIELD_K_GRID_LEFT
    def_bool $(shields_list_contains,totem_left)

config SHIELD_K_GRID_RIGHT
    def_bool $(shields_list_contains,totem_right)
```
